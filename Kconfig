## dts/bindings/serial/uart-bitbang.yaml
```yaml
description: UART bitbang

compatible: "zephyr,uart-bitbang"

properties:
  tx-gpios:
    type: phandle-array
    required: true
  rx-gpios:
    type: phandle-array
    required: true

include: uart-controller.yaml
```

## samples/drivers/uart/bitbang/sample.yaml
```yaml
sample:
  name: UART Bitbang Sample
tests:
  sample.drivers.uart.bitbang:
    tags:
      - uart
      - serial
```
